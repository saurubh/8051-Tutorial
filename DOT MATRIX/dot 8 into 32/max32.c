#include<reg51.h>
void delay(unsigned int itime)
{
	unsigned int a,b;
	for(a=0;a<itime;a++)
	for(b=0;b<1275;b++);
}
sbit SCK = P3^0;
sbit STR = P3^1;
sbit SDA = P3^2;
unsigned char col[] = {0x01,0x02,0x04,0x08,0x10,0x20,0x40,0x80},
row[] = {    0xff,0xff,0xff,0xff,0xff,0xff,0xff,0xff,
	           0xff,0xff,0xff,0xff,0xff,0xff,0xff,0xff,
	           0xff,0xff,0xff,0xff,0xff,0xff,0xff,0xff,
	           0xff,0x01,0xee,0xee,0x01,0xff,0xff,0xff,
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	           0xff,0xff,0xff,0xff,0xff,0xff,0xff,0xff,
};

void dat(unsigned char x)
{
	unsigned char temp,i;
	for(i=0;i<8;i++)
	{
		temp=x&0x80;
		if(temp==0x80)
		SDA=1;
		else 
		SDA = 0;
		x=x*2;
		SCK=0;
		SCK=1;
	}
}
void main()
{
	int i,j,k;
	while(1)
	{
		for(i=0;i<60;i++)
		{
		for(j=0;j<2;j++)
			{
				for(k=0;k<8;k++)
				{
          dat(row[i+k+24]);
					dat(row[i+k+16]);
					dat(row[i+k+8]);
					dat(row[i+k]);
					STR=0;
					STR=1;
					P2 = col[k];
					delay(1);
					P2 = 0x00;
				}
			}
		}
	}
}
